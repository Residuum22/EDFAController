## EDFABoards/Firmware/laser_board_firmware/components/wifi/Kconfig.projbuild
```kconfig
menu "Example Connection Configuration"

    orsource "$IDF_PATH/examples/common_components/env_caps/$IDF_TARGET/Kconfig.env_caps"
    
    config EXAMPLE_WIFI_SSID
        depends on !EXAMPLE_WIFI_SSID_PWD_FROM_STDIN
        string "WiFi SSID"
        default "myssid"
        help
            SSID (network name) for the example to connect to.

    config EXAMPLE_WIFI_PASSWORD
        depends on !EXAMPLE_WIFI_SSID_PWD_FROM_STDIN
        string "WiFi Password"
        default "mypassword"
        help
            WiFi password (WPA or WPA2) for the example to use.
            Can be left blank if the network has no security set.

    config EXAMPLE_WIFI_CONN_MAX_RETRY
        int "Maximum retry"
        default 100
        help
            Set the Maximum retry to avoid station reconnecting to the AP unlimited,
            in case the AP is really inexistent.

    choice EXAMPLE_WIFI_SCAN_METHOD
        prompt "WiFi Scan Method"
        default EXAMPLE_WIFI_SCAN_METHOD_ALL_CHANNEL
        help
            WiFi scan method:

            If "Fast" is selected, scan will end after find SSID match AP.

            If "All Channel" is selected, scan will end after scan all the channel.

        config EXAMPLE_WIFI_SCAN_METHOD_FAST
            bool "Fast"
        config EXAMPLE_WIFI_SCAN_METHOD_ALL_CHANNEL
            bool "All Channel"
    endchoice

    menu "WiFi Scan threshold"
        config EXAMPLE_WIFI_SCAN_RSSI_THRESHOLD
            int "WiFi minimum rssi"
            range -127 0

            default -127
            help
                The minimum rssi to accept in the scan mode.

        choice EXAMPLE_WIFI_SCAN_AUTH_MODE_THRESHOLD
            prompt "WiFi Scan auth mode threshold"
            default EXAMPLE_WIFI_AUTH_WPA2_PSK
            help
                The weakest authmode to accept in the scan mode.

            config EXAMPLE_WIFI_AUTH_OPEN
                bool "OPEN"
            config EXAMPLE_WIFI_AUTH_WPA_PSK
                bool "WPA PSK"
            config EXAMPLE_WIFI_AUTH_WPA2_PSK
                bool "WPA2 PSK"
            config EXAMPLE_WIFI_AUTH_WPA_WPA2_PSK
                bool "WPA WPA2 PSK"
            config EXAMPLE_WIFI_AUTH_WPA2_ENTERPRISE
                bool "WPA2 ENTERPRISE"
        endchoice
    endmenu

    choice EXAMPLE_WIFI_CONNECT_AP_SORT_METHOD
        prompt "WiFi Connect AP Sort Method"
        default EXAMPLE_WIFI_CONNECT_AP_BY_SIGNAL
        help
            WiFi connect AP sort method:

            If "Signal" is selected, Sort matched APs in scan list by RSSI.

            If "Security" is selected, Sort matched APs in scan list by security mode.

        config EXAMPLE_WIFI_CONNECT_AP_BY_SIGNAL
            bool "Signal"
        config EXAMPLE_WIFI_CONNECT_AP_BY_SECURITY
            bool "Security"
    endchoice

    config EXAMPLE_CONNECT_IPV4
        bool
        depends on LWIP_IPV4
        default y

endmenu
```

## EDFABoards/Firmware/laser_board_firmware/main/Kconfig.projbuild
```kconfig
menu "Laser Module Serial Number"

    config LASER_MODULE_NUMBER
        int "Serial of laser modules"
        range 1 3
        default 1

endmenu
```

## EDFABoards/Firmware/voa_board_firmware/components/voa_control/Kconfig.projbuild
```kconfig
menu "EPS value"

    config USE_EPS_VAR
        int "Get EPS from MQTT before initialization of VOA"
        range 0 1
        default 0
        help
            If true the voa board will wait, before the min max value initialization for eps. **USE FOR DEBUG ONLY**

endmenu
```
